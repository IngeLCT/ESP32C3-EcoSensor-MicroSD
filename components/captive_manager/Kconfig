## components/captive_manager/Kconfig
```kconfig
menu "Captive Manager"
    config CAPTIVE_MANAGER_ENABLE
        bool "Enable Captive Manager"
        default y

    config CAPTIVE_MANAGER_AP_SSID
        string "AP SSID temporal"
        default "ESP-LOGIN"

    config CAPTIVE_MANAGER_AP_PASS
        string "AP password temporal (>=8 chars para WPA2)"
        default "esp32login"

    config CAPTIVE_MANAGER_MAX_SCAN_APS
        int "Máximo de APs listados en /scan"
        default 20

    config CAPTIVE_MANAGER_CONN_MAX_ATTEMPTS
        int "Máx. reintentos conexión con credenciales guardadas"
        default 5

    config CAPTIVE_MANAGER_CONN_RETRY_DELAY_MS
        int "Delay (ms) entre reintentos guardados"
        default 4000

    config CAPTIVE_MANAGER_BOOT_GRACE_MS
        int "Ventana de gracia tras arranque (ms) antes de volver al Wi-Fi manager"
        default 180000
endmenu
```

## sdkconfig.defaults
```kconfig
CONFIG_IDF_TARGET="esp32c3"
# CONFIG_PARTITION_TABLE_SINGLE_APP is not set
CONFIG_PARTITION_TABLE_SINGLE_APP_LARGE=y
# CONFIG_PARTITION_TABLE_TWO_OTA is not set
# CONFIG_PARTITION_TABLE_TWO_OTA_LARGE is not set
# CONFIG_PARTITION_TABLE_CUSTOM is not set
CONFIG_PARTITION_TABLE_FILENAME="partitions_singleapp_large.csv"
CONFIG_PARTITION_TABLE_OFFSET=0x8000
CONFIG_PARTITION_TABLE_MD5=y
```
